## app/boards/shields/lotus58/Kconfig.defconfig
```kconfig
if SHIELD_LOTUS58_LEFT

config ZMK_KEYBOARD_NAME
    default "Lotus58 Left"

config ZMK_SPLIT_BLE_ROLE_CENTRAL
    default y

endif

if SHIELD_LOTUS58_RIGHT

config ZMK_KEYBOARD_NAME
    default "Lotus58 Right"

endif

if SHIELD_LOTUS58_LEFT || SHIELD_LOTUS58_RIGHT

config ZMK_SPLIT
    default y

endif
```

## app/boards/shields/lotus58/Kconfig.shield
```kconfig
config SHIELD_LOTUS58_LEFT
    def_bool $(shields_list_contains,lotus58_left)

config SHIELD_LOTUS58_RIGHT
    def_bool $(shields_list_contains,lotus58_right)
```
